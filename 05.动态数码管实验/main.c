/********************************* 深圳市航太电子有限公司 *******************************
* 实 验 名 ：动态数码管实验
* 实验说明 ：0到100循环计数，并显示到数码管上，4个数码管循环显示，因为显示频率很快，看起来是同时显示的
* 实验平台 ：航太51单片机开发板 V1.1
* 连接方式 ：CN3接CN16，A接P00，B接P01，C接P02，D接P03，E接P04，F接P05，G接P06，DP接P07
*            CN1接CN17，PUT1接P24，PUT2接P25，PUT3接P26，PUT4接P27
* 注    意 ：数码管为共阳数码管，也就是说段选接口低有效，而公共端经过PNP三极管，所以位选接口低有效
*            该函数是在主函数中不断循环执行的，每一个数码管给1ms的显示时间，在这1ms内其实只有一个数码管被点亮，
*            其他数码管是熄灭的，但是由于扫描速度很快，人眼就感觉是同时点亮的。
* 作    者 ：航太电子产品研发部    QQ ：1909197536
* 店    铺 ：http://shop120013844.taobao.com/
****************************************************************************************/

#include <reg52.h>
#include <intrins.h>

#define FOSC 11059200L //晶振设置，默认使用11.0592M Hz
//#define FOSC 12000000L //晶振设置，使用12M Hz
//#define FOSC 24000000L //晶振设置，使用24M Hz

#define TIME_MS 50 //设定定时时间 ms ,在11.0592M晶振下，不易超过60ms

//IO接口定义
#define LED_PORT P0
sbit wela_1 = P2^4;
sbit wela_2 = P2^5;
sbit wela_3 = P2^6;
sbit wela_4 = P2^7;

//全局变量定义
unsigned char count,temp;

//LED显示字模 0-F 共阳模式
unsigned code table[]= {0Xc0,0xf9,0xa4,0xb0,0x99,0x92,0x82,0xf8,0x80,0x90,0x88,0x83,0xc6,0xa1,0x86,0x8e};

/*******************************************************************************
* 函 数 名 ：Delayms
* 函数功能 ：实现 ms级的延时
* 输    入 ：ms
* 输    出 ：无
*******************************************************************************/
void Delayms(unsigned int ms)
{
	unsigned int i,j;
	for(i=0;i<ms;i++)
	#if FOSC == 11059200L
		for(j=0;j<114;j++);
	#elif FOSC == 12000000L
	  for(j=0;j<123;j++);
	#elif FOSC == 24000000L
		for(j=0;j<249;j++);
	#else
		for(j=0;j<114;j++);
	#endif
}

/*******************************************************************************
* 函 数 名 ：Timer0Init
* 函数功能 ：定时器0初始化
* 输    入 ：无
* 输    出 ：无
*******************************************************************************/
void Timer0Init()
{
	TMOD=0x01; //设置定时器0工作方式为1
	TH0=(65536-FOSC/12/1000*TIME_MS)/256;
	TL0=(65536-FOSC/12/1000*TIME_MS)%256;
	ET0=1; //开启定时器0中断
	TR0=1;	//开启定时器	
	EA=1;  //打开总中断
}

/*******************************************************************************
* 函 数 名 ：LEDdisplay
* 函数功能 ：循环显示各个位上的数据
* 输    入 ：num 需要显示的数据
* 输    出 ：无
*******************************************************************************/
void LEDdisplay(unsigned int num)
{
	unsigned char qian,bai,shi,ge;
	qian=num/1000;
	bai=num%1000/100;
	shi=num%100/10;
	ge=num%10;
	
	wela_1 = 1;	  //关闭所有数码管
	wela_2 = 1;
	wela_3 = 1;
	wela_4 = 1;	

	wela_4=0;  //显示千位
	LED_PORT=table[qian];
	Delayms(1);
	LED_PORT = 0xff;
	wela_4=1;
	
	wela_3=0;  //显示百位
	LED_PORT=table[bai];
	Delayms(1);
	LED_PORT = 0xff;
	wela_3=1;
	
	wela_2=0;  //显示十位
	LED_PORT=table[shi];
	Delayms(1);
	LED_PORT = 0xff;
	wela_2=1;
	
	wela_1=0;  //显示个位
	LED_PORT=table[ge];
	Delayms(1);
	LED_PORT = 0xff;
}

/*******************************************************************************
* 函 数 名 ：main
* 函数功能 ：主函数
* 输    入 ：无
* 输    出 ：无
*******************************************************************************/
void main()
{
	Timer0Init();
	count = 0;
	temp = 0;
	while(1)
	{ 
		if(count==20)//达到1s
		  {
			count=0;
			temp++;
			if(temp==100)
			   {
					temp=0;
			   }
		  }
		LEDdisplay(temp);
	}
}

/*******************************************************************************
* 函 数 名 ：Timer0Int
* 函数功能 ：定时器0中断函数 ， 每隔TIME_MS ms进入
* 输    入 ：无
* 输    出 ：无
*******************************************************************************/
void Timer0Int() interrupt 1
{
	TH0=(65536-FOSC/12/1000*TIME_MS)/256;
	TL0=(65536-FOSC/12/1000*TIME_MS)%256;
	count++;	
}

